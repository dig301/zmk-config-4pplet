## config/boards/4pplet/cyber60/Kconfig.board
```kconfig
# Copyright (c) 2022 The ZMK Contributors
# Copyright (c) 2022 Stefan Sundin (4pplet)
# SPDX-License-Identifier: MIT

config BOARD_CYBER60
    select SOC_NRF52840_QIAA
    select ZMK_BOARD_COMPAT if BOARD_CYBER60_NRF52840_ZMK
    imply RETAINED_MEM if BOARD_CYBER60_NRF52840_ZMK
    imply RETENTION if BOARD_CYBER60_NRF52840_ZMK
    imply RETENTION_BOOT_MODE if BOARD_CYBER60_NRF52840_ZMK
```

## config/boards/4pplet/cyber60/Kconfig.cyber60
```kconfig
# Copyright (c) 2022 The ZMK Contributors
# Copyright (c) 2022 Stefan Sundin (4pplet)
# SPDX-License-Identifier: MIT

config BOARD_CYBER60
    select SOC_NRF52840_QIAA
    select ZMK_BOARD_COMPAT
    imply RETAINED_MEM
    imply RETENTION
    imply RETENTION_BOOT_MODE
```

## config/boards/4pplet/cyber60/Kconfig.defaults
```kconfig
# SPDX-License-Identifier: MIT

choice ZMK_BOOTMODE_MAGIC_VALUE_BOOTLOADER_TYPE
    default ZMK_BOOTMODE_MAGIC_VALUE_BOOTLOADER_TYPE_ADAFRUIT_NRF52
endchoice
```

## config/boards/4pplet/cyber60/Kconfig.defconfig
```kconfig
# Copyright (c) 2022 The ZMK Contributors
# Copyright (c) 2022 Stefan Sundin (4pplet)
# SPDX-License-Identifier: MIT

if BOARD_CYBER60

config BOARD_DESCRIPTION
    string
    default "Cyber60 keyboard"

endif # BOARD_CYBER60
```

## config/boards/4pplet/cyber60/board.yml
```yaml
board:
  name: cyber60
  vendor: 4pplet
  socs:
    - name: nrf52840
  revision:
    format: custom
    default: rev_d
    revisions:
      - name: rev_d
```

## config/boards/4pplet/cyber60/cyber60_nrf52840_defconfig
```kconfig
# SPDX-License-Identifier: MIT

CONFIG_ARM_MPU=y
CONFIG_SYS_CLOCK_HW_CYCLES_PER_SEC=64000000

CONFIG_PINCTRL=y
CONFIG_GPIO=y

CONFIG_PWM=y
CONFIG_PWM_NRFX=y

CONFIG_USE_DT_CODE_PARTITION=y
CONFIG_BUILD_OUTPUT_UF2=y

CONFIG_FLASH=y
CONFIG_FLASH_PAGE_LAYOUT=y
CONFIG_FLASH_MAP=y

CONFIG_MPU_ALLOW_FLASH_WRITE=y
CONFIG_NVS=y
CONFIG_SETTINGS_NVS=y

CONFIG_RETAINED_MEM=y
CONFIG_RETENTION=y
CONFIG_RETENTION_BOOT_MODE=y

CONFIG_ZMK_USB=y
CONFIG_ZMK_BLE=y

CONFIG_ZMK_RGB_UNDERGLOW=y
CONFIG_ZMK_RGB_UNDERGLOW_EXT_POWER=y
CONFIG_ZMK_RGB_UNDERGLOW_ON_START=n

CONFIG_EC11=y
CONFIG_EC11_TRIGGER_GLOBAL_THREAD=y

CONFIG_ZMK_STUDIO=y
CONFIG_ZMK_STUDIO_LOCKING=n

CONFIG_USB_CDC_ACM=y
CONFIG_SERIAL=y
CONFIG_UART_INTERRUPT_DRIVEN=y
CONFIG_UART_LINE_CTRL=y

CONFIG_ZMK_SLEEP=y
CONFIG_ZMK_IDLE_SLEEP_TIMEOUT=2700000
```

## config/boards/4pplet/cyber60/cyber60_nrf52840_zmk_1_0_0_defconfig
```kconfig
# SPDX-License-Identifier: MIT

CONFIG_ARM_MPU=y
CONFIG_SYS_CLOCK_HW_CYCLES_PER_SEC=64000000

CONFIG_RESET=y
CONFIG_CLOCK_CONTROL=y

CONFIG_PINCTRL=y
CONFIG_GPIO=y

CONFIG_USE_DT_CODE_PARTITION=y
CONFIG_BUILD_OUTPUT_UF2=y

CONFIG_MPU_ALLOW_FLASH_WRITE=y
CONFIG_NVS=y
CONFIG_SETTINGS_NVS=y
CONFIG_FLASH=y
CONFIG_FLASH_PAGE_LAYOUT=y
CONFIG_FLASH_MAP=y

CONFIG_RETAINED_MEM=y
CONFIG_RETENTION=y
CONFIG_RETENTION_BOOT_MODE=y

CONFIG_ZMK_USB=y
CONFIG_ZMK_BLE=y
CONFIG_ZMK_KSCAN_MATRIX_POLLING=y

CONFIG_HW_STACK_PROTECTION=y

CONFIG_ZMK_RGB_UNDERGLOW=y
CONFIG_ZMK_RGB_UNDERGLOW_HUE_START=0
CONFIG_ZMK_RGB_UNDERGLOW_EFF_START=0
```

## config/boards/4pplet/cyber60_rev_d/Kconfig.cyber60_rev_d
```kconfig
# cyber60 board configuration

# Copyright (c) 2022 Stefan Sundin (4pplet)
# SPDX-License-Identifier: MIT

config BOARD_CYBER60_REV_D
	select SOC_NRF52840_QIAA
```

## config/boards/4pplet/cyber60_rev_d/board.yml
```yaml
board:
  name: cyber60_rev_d
  vendor: 4pplet
  revision:
    format: number
    default: "4"
    revisions:
      - name: "4"
  socs:
    - name: nrf52840
      variants:
        - name: nrf52840
        - name: zmk
```

## config/boards/shields/c60d/Kconfig.defconfig
```kconfig
if SHIELD_C60D

config ZMK_KEYBOARD_NAME
    default "C60"

config ZMK_SPLIT_ROLE_CENTRAL
    default y

config ZMK_SPLIT
    default y

config ZMK_SPLIT_BLE_CENTRAL_PERIPHERALS
    default 1

config BT_MAX_CONN
    default 6

config BT_MAX_PAIRED
    default 6

config ZMK_BOARD_COMPAT
    default y

endif
```

## config/boards/shields/c60d/Kconfig.shield
```kconfig
# Copyright (c) 2024 4pplet
# SPDX-License-Identifier: MIT

config SHIELD_C60D
    def_bool $(shields_list_contains,c60d)
```

## config/boards/shields/cyber60_dongle/Kconfig.defconfig
```kconfig
if SHIELD_CYBER60_DONGLE

config ZMK_KEYBOARD_NAME
    default "Cyber60 Dongle"

config ZMK_SPLIT_ROLE_CENTRAL
    default y

config ZMK_SPLIT
    default y

config ZMK_SPLIT_BLE_CENTRAL_PERIPHERALS
    default 1

config BT_MAX_CONN
    default 6

config BT_MAX_PAIRED
    default 6

endif
```

## config/boards/shields/cyber60_dongle/Kconfig.shield
```kconfig
config SHIELD_CYBER60_DONGLE
    def_bool $(shields_list_contains,cyber60_dongle)
```

## config/boards/shields/cyber60_left/Kconfig.defconfig
```kconfig
if SHIELD_CYBER60_LEFT

config ZMK_KEYBOARD_NAME
    default "C60 Left"

config ZMK_SPLIT
    default y

endif
```

## config/boards/shields/cyber60_peripheral/Kconfig.defconfig
```kconfig
if SHIELD_CYBER60_PERIPHERAL

config ZMK_SPLIT_BLE_PERIPHERAL
    default y

config ZMK_USB
    default n

endif
```

## config/boards/shields/cyber60_peripheral/Kconfig.shield
```kconfig
config SHIELD_CYBER60_PERIPHERAL
    def_bool $(shields_list_contains,cyber60_peripheral)
```

## config/west.yml
```yaml
manifest:
  remotes:
    - name: zmkfirmware
      url-base: https://github.com/zmkfirmware
    - name: carrefinho
      url-base: https://github.com/carrefinho
    - name: seeed
      url-base: https://github.com/Seeed-Studio
  projects:
    - name: zmk
      remote: zmkfirmware
      revision: main
      import: app/west.yml
    - name: seeed-xiao-ble-zmk
      remote: seeed
      revision: release
    - name: prospector-zmk-module
      remote: carrefinho
      revision: main
  self:
    path: config
```
